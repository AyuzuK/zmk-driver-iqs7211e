## Kconfig
```kconfig
menuconfig IQS7211E
    bool "IQS7211E capcacitive touch sensor"
  select I2C
    help
      Enable IQS7211E capcacitive touch sensor.

if IQS7211E

config IQS7211E_TAP_EDGE_MARGIN_PERMILLE
    int "Tap ignore edge margin (permille)"
    range 0 450
    default 80
    help
      Edge margin used to suppress tap/click detection in scroller mode.
      80 means 8 percent margin from each edge.

config IQS7211E_MOTION_START_THRESHOLD
    int "Pointer motion start threshold (sensor counts)"
    range 0 1000
    default 0
    help
      Suppress pointer X/Y reports until the finger has moved this distance
      (|dx| + |dy|) from the touch start position. Movement up to and
      including the report that crosses the threshold is discarded.
      Not applied to scroller mode or two finger scroll.
      0 disables this feature.

config IQS7211E_GESTURE_DOUBLE_TAP_WAIT_MS
    int "Gesture mode: double tap wait time (ms)"
    range 50 2000
    default 300
    help
      Used only with the gesture-mode property. After a tap, the single tap
      signal is sent when this time passes without a second touch.
      A second tap starting within this time sends the double tap signal.

config IQS7211E_GESTURE_TAP_TIME_MS
    int "Gesture mode: maximum tap duration (ms)"
    range 50 1000
    default 200
    help
      Used only with the gesture-mode property. A touch shorter than this
      time (with small movement) is treated as a tap.

config IQS7211E_GESTURE_TAP_DISTANCE
    int "Gesture mode: maximum tap movement (sensor counts)"
    range 1 1000
    default 50
    help
      Used only with the gesture-mode property. A touch that moved less than
      this distance (|dx| + |dy|) is treated as a tap.

config IQS7211E_GESTURE_SWIPE_DISTANCE_PERMILLE
    int "Gesture mode: minimum vertical swipe distance (permille of Y size)"
    range 1 1000
    default 200
    help
      Used only with the gesture-mode property. A vertical movement of at
      least this ratio of the Y resolution is treated as a swipe.

config IQS7211E_GESTURE_SWIPE_MAX_TIME_MS
    int "Gesture mode: maximum swipe duration (ms)"
    range 50 2000
    default 500
    help
      Used only with the gesture-mode property. A swipe must finish
      (finger released) within this time.

config IQS7211E_GESTURE_LONG_PRESS_MS
    int "Gesture mode: long press time (ms)"
    range 0 5000
    default 500
    help
      Used only with the gesture-mode property. A one finger touch that
      stays within the long press distance for this time sends the long
      press signal at that moment, without waiting for the release.
      The touch then sends no tap, swipe or click signal.
      A touch that starts within the double tap wait is not used.
      0 disables the long press signal.

config IQS7211E_GESTURE_LONG_PRESS_DISTANCE
    int "Gesture mode: maximum long press movement (sensor counts)"
    range 1 1000
    default 30
    help
      Used only with the gesture-mode property. A touch that moved this
      distance (|dx| + |dy|) or more from the touch start position does
      not send the long press signal.

config IQS7211E_GESTURE_SIGNAL_RELEASE_MS
    int "Gesture mode: signal press to release time (ms)"
    range 1 1000
    default 30
    help
      Used only with the gesture-mode property. Time between the press and
      the release of a gesture signal.

config IQS7211E_SCROLLER_HWHEEL_ZONE_MIN_PERMILLE
    int "HWheel zone start (permille)"
    range 0 1000
    default 0
    help
      Start position of the horizontal scroll zone in permille of Y size.
      This value and MAX define a band [MIN, MAX).

config IQS7211E_SCROLLER_HWHEEL_ZONE_MAX_PERMILLE
    int "HWheel zone end (permille)"
    range 0 1000
    default 150
    help
      End position of the horizontal scroll zone in permille of Y size.
      This value and MIN define a band [MIN, MAX).

config IQS7211E_SCROLLER_INERTIA
    bool "Enable inertia scrolling in scroller mode"
    default n
    help
      Keep sending wheel events after finger release when the device is in
      scroller mode. Uses fixed-point integer math (no FPU required).

config IQS7211E_SCROLLER_INERTIA_DECAY_PERMILLE
    int "Inertia decay coefficient (permille)"
    range 1 999
    default 920
    depends on IQS7211E_SCROLLER_INERTIA
    help
      Velocity multiplier applied every 10ms tick.
      920 means velocity = velocity * 0.92 per tick.

config IQS7211E_SCROLLER_INERTIA_STOP_THRESHOLD_Q8
    int "Inertia stop threshold (Q8 wheel units per 10ms)"
    range 1 4096
    default 96
    depends on IQS7211E_SCROLLER_INERTIA
    help
      Inertia stops immediately when absolute velocity goes below this value.
      Q8 means 256 equals 1 wheel unit per 10ms.

endif
```

## dts/bindings/azoteq,iqs7211e.yaml
```yaml
# Copyright 2025 sekigon-gonnoc
# SPDX-License-Identifier: GPL-2.0 or later

description: IQS7211E capacitive touch sensor

compatible: "azoteq,iqs7211e"

include: i2c-device.yaml

properties:
  irq-gpios:
    type: phandle-array
    required: true
    description: |
      GPIO connected to the motion pin, active low.

  power-gpios:
    type: phandle-array
    required: false
    description: |
      GPIO connected to the power control pin.

  init-symbol:
    type: string
    required: false
    default: "iqs7211e_init_default"
    description: |
      C identifier (symbol) name of a `const uint8_t` array defined in the
      board/project code which contains the initialization records for this
      instance. The driver will reference this symbol as the init data for
      the instance.

      Example value: "trackpad0_iqs7211e_init"  (do NOT quote as a C string
      in the YAML; the value is the identifier itself).
      Provide `init-length` (integer) with the byte length of the array.
      If `init-symbol` is not set for a node, the driver uses the module's
      default symbol `iqs7211e_init_default` defined in the driver.

  init-length:
    type: int
    required: false
    default: 217
    description: |
      Length in bytes of the `init-symbol` array. Required when `init-symbol`
      is provided.

  scroller-mode:
    type: boolean
    required: false
    description: |
      When present, finger movement is reported as `INPUT_REL_WHEEL`
      instead of pointer X/Y movement. Tap-to-click behavior remains active.

  gesture-mode:
    type: boolean
    required: false
    description: |
      When present, taps and vertical swipes are reported as gesture signals
      instead of mouse clicks:
      INPUT_BTN_5 = single tap, INPUT_BTN_6 = double tap,
      INPUT_BTN_7 = swipe up, INPUT_BTN_8 = swipe down,
      INPUT_BTN_9 = click (first tap release, or held during a second touch
      within the double tap wait),
      INPUT_BTN_MODE = long press (one finger kept still).
      Tap-to-click, two finger tap right click and double tap hold are
      disabled. Pointer movement and two finger scroll are reported as usual.
      Independent of scroller-mode.

  v-invert:
    type: boolean
    required: false
    description: |
      In scroller mode, invert vertical wheel direction.
      When present, upward/downward finger movement direction is swapped
      for `INPUT_REL_WHEEL` reports.

  h-invert:
    type: boolean
    required: false
    description: |
      In scroller mode, invert horizontal wheel direction.
      When present, left/right finger movement direction is swapped
      for `INPUT_REL_HWHEEL` reports.
```
